## Documentation/devicetree/bindings/media/google,gs201-csis.yaml
```yaml
# SPDX-License-Identifier: GPL-2.0-only OR BSD-2-Clause
%YAML 1.2
---
$id: http://devicetree.org/schemas/media/google,gs201-csis.yaml#
$schema: http://devicetree.org/meta-schemas/core.yaml#

title: Google gs101 and gs201 CSIS camera receiver link and CSIS WDMA

maintainers:
  - Derek Ross <derekross@gmail.com>

description:
  The camera block of Google's gs201 SoC has eight MIPI CSI-2 receiver links
  (CSIS) and a DMA block whose CSIS WDMA contexts write a link's frames to
  memory. One node describes one link and the WDMA context it feeds.

properties:
  compatible:
    oneOf:
      - const: google,gs201-csis
      - items:
          - const: google,gs101-csis
          - const: google,gs201-csis

  reg:
    minItems: 3
    items:
      - description: the CSIS link registers
      - description: the CSIS DMA block's common page (shared by all links)
      - description: the CSIS WDMA context (links may share one; they then
          stream one at a time)
      - description: the EBUF control (shared by all links), bypassed on the
          way to the WDMA

  reg-names:
    minItems: 3
    items:
      - const: link
      - const: dma
      - const: wdma
      - const: ebuf

  interrupts:
    items:
      - description: link interrupt
      - description: WDMA context interrupt

  interrupt-names:
    items:
      - const: link
      - const: wdma

  clocks:
    minItems: 1
    maxItems: 4
    description:
      The camera block's (cam) and the bus's (int) DVFS domains, and the
      link's (link) and the CSIS DMA's (dma) gates in the camera block's
      clock controller, which loses its state with the block's power
      domain (gs101). gs101 has no CAM DVFS domain, so its cam clock is the
      CSIS bus divider in CMU_TOP.

  clock-names:
    minItems: 1
    maxItems: 4
    items:
      enum:
        - cam
        - int
        - link
        - dma

  phys:
    maxItems: 1
    description: The link's DC-PHY receiver.

  google,csis-link:
    $ref: /schemas/types.yaml#/definitions/uint32
    maximum: 7
    description: Index of the CSIS link.

  google,wdma-context:
    $ref: /schemas/types.yaml#/definitions/uint32
    maximum: 3
    description: Index of the CSIS WDMA context.

  google,csis-sysreg:
    $ref: /schemas/types.yaml#/definitions/phandle
    description:
      The camera block's system registers, which route a link through an
      EBUF to a WDMA context.

  google,ebuf:
    $ref: /schemas/types.yaml#/definitions/uint32
    maximum: 3
    description:
      WDMA input slot the link is routed to; defaults to the context index.

  google,lrte-packet-delimiters:
    type: boolean
    description:
      The sensor ends its C-PHY packets with LRTE packet delimiters (EPD),
      which the link must be told to expect; without it, such a link
      decodes frame starts and nothing else.

  memory-region:
    maxItems: 1
    description: Pool for capture buffers the WDMA can address.

  power-domains:
    maxItems: 1

  iommus:
    maxItems: 1

  port:
    $ref: /schemas/graph.yaml#/$defs/port-base
    unevaluatedProperties: false
    description: Input port, connected to the sensor.

    properties:
      endpoint:
        $ref: video-interfaces.yaml#
        unevaluatedProperties: false

        properties:
          bus-type:
            enum:
              - 1 # MEDIA_BUS_TYPE_CSI2_CPHY
              - 4 # MEDIA_BUS_TYPE_CSI2_DPHY
            description:
              D-PHY when absent. C-PHY counts trios in data-lanes (up to
              three on links 0 and 1, two on the others).
          data-lanes:
            minItems: 1
            maxItems: 4

        required:
          - data-lanes

required:
  - compatible
  - reg
  - reg-names
  - interrupts
  - interrupt-names
  - phys
  - google,csis-link
  - google,wdma-context
  - google,csis-sysreg
  - port

additionalProperties: false

examples:
  - |
    #include <dt-bindings/interrupt-controller/arm-gic.h>
    csis@1a440000 {
        compatible = "google,gs201-csis";
        reg = <0x1a440000 0x1000>, <0x1a4d0000 0x1000>, <0x1a4d7000 0x1000>;
        reg-names = "link", "dma", "wdma";
        interrupts = <GIC_SPI 189 IRQ_TYPE_LEVEL_HIGH>,
                     <GIC_SPI 197 IRQ_TYPE_LEVEL_HIGH>;
        interrupt-names = "link", "wdma";
        phys = <&csis_dcphy 0>;
        google,csis-link = <0>;
        google,wdma-context = <0>;
        google,csis-sysreg = <&sysreg_csis>;

        port {
            csis_in: endpoint {
                remote-endpoint = <&sensor_out>;
                data-lanes = <1 2 3 4>;
            };
        };
    };
```
